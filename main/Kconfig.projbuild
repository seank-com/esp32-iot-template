## main/Kconfig.projbuild
```kconfig
menu "Example Configuration"

config WIFI_SSID
    string "WiFi SSID"
	default "myssid"
	help
		SSID (network name) for the example to connect to.

config WIFI_PASSWORD
    string "WiFi Password"
	default "myssid"
	help
		WiFi password (WPA or WPA2) for the example to use.

		Can be left blank if the network has no security set.

config IOTHUB_CONNECTION_STRING
    string "IoTHub Connection String"
  default ""
  help
    Program will fail to connect to IoTHub without a valid value

    Can be found in the IoT Devices section of the IoTHub blade in
    the Azure Portal at https://portal.azure.com
    
endmenu
```
